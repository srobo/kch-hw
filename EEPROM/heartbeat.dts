/dts-v1/;
/plugin/;

/ {
    compatible = "brcm,bcm2708";

    fragment@0 {
        target = <&leds>;
        __overlay__ {
            hb_led: led {
                label = "hb_led";
                gpios = <&gpio 19 0>;
                linux,default-trigger = "heartbeat";
            };
        };
    };
};